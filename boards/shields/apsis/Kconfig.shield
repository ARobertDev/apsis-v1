## boards/shields/apsis/Kconfig.shield
```kconfig
config SHIELD_APSIS_LEFT
    def_bool $(shields_list_contains,apsis_left)

config SHIELD_APSIS_RIGHT
    def_bool $(shields_list_contains,apsis_right)
```
